## Yocto_Project/conf/bblayers.conf
```bitbake
# POKY_BBLAYERS_CONF_VERSION is increased each time build/conf/bblayers.conf
# changes incompatibly
POKY_BBLAYERS_CONF_VERSION = "2"

BBPATH = "${TOPDIR}"
BBFILES ?= ""

BBLAYERS ?= " \
  /home/ubuntu/yocto/poky/meta \
  /home/ubuntu/yocto/poky/meta-poky \
  /home/ubuntu/yocto/poky/meta-yocto-bsp \
  /home/ubuntu/yocto/meta-raspberrypi \
  /home/ubuntu/yocto/meta-openembedded/meta-oe \
  /home/ubuntu/yocto/meta-openembedded/meta-python \
  /home/ubuntu/yocto/meta-openembedded/meta-networking \
  /home/ubuntu/yocto/meta-custom-weather-layer \
  "
```

## Yocto_Project/meta-custom-weather-layer/conf/layer.conf
```bitbake
# We have a conf and classes directory, add to BBPATH
BBPATH .= ":${LAYERDIR}"

# We have recipes-* directories, add to BBFILES
BBFILES += "${LAYERDIR}/recipes-*/*/*.bb \
            ${LAYERDIR}/recipes-*/*/*.bbappend"

BBFILE_COLLECTIONS += "meta-custom-rpi-overlay"
BBFILE_PATTERN_meta-custom-rpi-overlay = "^${LAYERDIR}/"
BBFILE_PRIORITY_meta-custom-rpi-overlay = "40"

LAYERDEPENDS_meta-custom-rpi-overlay = "core"
LAYERSERIES_COMPAT_meta-custom-rpi-overlay = "kirkstone"
```
